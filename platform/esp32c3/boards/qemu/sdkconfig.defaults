## platform/esp32c3/boards/qemu/sdkconfig.defaults
```kconfig
# rt-claw Quick Demo — interactive shell + full AI agent
#
# Usage:
#   cp sdkconfig.defaults.demo sdkconfig.defaults
#   rm -f sdkconfig
#   idf.py set-target esp32c3
#   idf.py menuconfig   # set your API key in rt-claw -> AI Engine
#   idf.py build
#
# Enables: Shell, all tools, skills, scheduler, swarm, LCD
# Disables: Feishu

# ---- Base platform ----
CONFIG_FREERTOS_HZ=1000
CONFIG_FREERTOS_TIMER_TASK_STACK_DEPTH=4096
CONFIG_ESP_SYSTEM_EVENT_TASK_STACK_SIZE=4096
CONFIG_ETH_ENABLED=y
CONFIG_ETH_USE_OPENETH=y
CONFIG_LWIP_DNS_SUPPORT_MDNS_QUERIES=n
CONFIG_ESP_CONSOLE_UART_DEFAULT=y
CONFIG_ESP_CONSOLE_UART_BAUDRATE=115200
CONFIG_ESPTOOLPY_FLASHSIZE_4MB=y
CONFIG_ESPTOOLPY_FLASHSIZE="4MB"
CONFIG_PARTITION_TABLE_CUSTOM=y
CONFIG_PARTITION_TABLE_CUSTOM_FILENAME="boards/qemu/partitions.csv"
CONFIG_MBEDTLS_CERTIFICATE_BUNDLE=y
CONFIG_MBEDTLS_CERTIFICATE_BUNDLE_DEFAULT_FULL=y
CONFIG_MBEDTLS_SSL_PROTO_TLS1_3=y
CONFIG_ESP_MAIN_TASK_STACK_SIZE=16384
CONFIG_ESP32C3_REV_MIN_0=y
CONFIG_COMPILER_OPTIMIZATION_SIZE=y
CONFIG_NEWLIB_STDIN_LINE_ENDING_LF=y

# ---- rt-claw modules ----
CONFIG_RTCLAW_SHELL_ENABLE=y
CONFIG_RTCLAW_LCD_ENABLE=y
CONFIG_RTCLAW_SWARM_ENABLE=y
CONFIG_RTCLAW_SCHED_ENABLE=y
CONFIG_RTCLAW_SKILL_ENABLE=y
CONFIG_RTCLAW_TOOL_GPIO=y
CONFIG_RTCLAW_TOOL_SYSTEM=y
CONFIG_RTCLAW_TOOL_LCD=y
CONFIG_RTCLAW_TOOL_SCHED=y
CONFIG_RTCLAW_TOOL_NET=y

# ---- WiFi provisioning off (QEMU uses Ethernet, not WiFi) ----
# Note: CONFIG_ESP_WIFI_ENABLED cannot be disabled — it is a hidden
# auto-set Kconfig flag based on SOC_WIFI_SUPPORTED (always y for
# ESP32-C3/S3). wifi_board.c and wifi_manager.c compile for QEMU
# but are never called (QEMU board.c is a no-op).
# CONFIG_RTCLAW_WIFI_PROVISION_ENABLE is not set

# ---- Feishu off ----
# CONFIG_RTCLAW_FEISHU_ENABLE is not set

# ---- Telegram off ----
# CONFIG_RTCLAW_TELEGRAM_ENABLE is not set
```

## platform/esp32s3/boards/qemu/sdkconfig.defaults
```kconfig
# rt-claw ESP32-S3 QEMU — full demo + API + Feishu

# ---- Base platform ----
CONFIG_FREERTOS_HZ=1000
CONFIG_FREERTOS_TIMER_TASK_STACK_DEPTH=4096
CONFIG_ESP_SYSTEM_EVENT_TASK_STACK_SIZE=4096
CONFIG_ETH_ENABLED=y
CONFIG_ETH_USE_OPENETH=y
CONFIG_LWIP_DNS_SUPPORT_MDNS_QUERIES=n
CONFIG_ESP_CONSOLE_UART_DEFAULT=y
CONFIG_ESP_CONSOLE_UART_BAUDRATE=115200
CONFIG_ESPTOOLPY_FLASHSIZE_4MB=y
CONFIG_ESPTOOLPY_FLASHSIZE="4MB"
CONFIG_PARTITION_TABLE_CUSTOM=y
CONFIG_PARTITION_TABLE_CUSTOM_FILENAME="boards/qemu/partitions.csv"
CONFIG_MBEDTLS_CERTIFICATE_BUNDLE=y
CONFIG_MBEDTLS_CERTIFICATE_BUNDLE_DEFAULT_FULL=y
CONFIG_MBEDTLS_SSL_PROTO_TLS1_3=y
CONFIG_ESP_MAIN_TASK_STACK_SIZE=16384
CONFIG_ESP32S3_REV_MIN_0=y
CONFIG_COMPILER_OPTIMIZATION_SIZE=y
CONFIG_NEWLIB_STDIN_LINE_ENDING_LF=y

# ---- rt-claw modules ----
CONFIG_RTCLAW_SHELL_ENABLE=y
CONFIG_RTCLAW_LCD_ENABLE=y
CONFIG_RTCLAW_SWARM_ENABLE=y
CONFIG_RTCLAW_SCHED_ENABLE=y
CONFIG_RTCLAW_SKILL_ENABLE=y
CONFIG_RTCLAW_TOOL_GPIO=y
CONFIG_RTCLAW_TOOL_SYSTEM=y
CONFIG_RTCLAW_TOOL_LCD=y
CONFIG_RTCLAW_TOOL_SCHED=y
CONFIG_RTCLAW_TOOL_NET=y

# ---- WiFi provisioning off (QEMU uses Ethernet, not WiFi) ----
# Note: CONFIG_ESP_WIFI_ENABLED cannot be disabled — it is a hidden
# auto-set Kconfig flag based on SOC_WIFI_SUPPORTED (always y for
# ESP32-C3/S3). wifi_board.c and wifi_manager.c compile for QEMU
# but are never called (QEMU board.c is a no-op).
# CONFIG_RTCLAW_WIFI_PROVISION_ENABLE is not set

# ---- QEMU workaround: disable HW SHA (QEMU ESP32-S3 SHA DMA bug) ----
# CONFIG_MBEDTLS_HARDWARE_SHA is not set

# ---- Feishu (Lark) ----
# CONFIG_RTCLAW_FEISHU_ENABLE=y

# ---- Telegram Bot ----
# CONFIG_RTCLAW_TELEGRAM_ENABLE is not set
```
